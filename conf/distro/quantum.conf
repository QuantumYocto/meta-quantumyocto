## conf/distro/quantum.conf
```bitbake
require conf/distro/poky.conf

DISTRO = "quantum"
DISTRO_NAME = "quantum distro"
DISTRO_VERSION = "1.0"

PACKAGE_CLASSES = "package_ipk"
PACKAGE_FEED_URIS = "http://www.setme.org/ipk/"
```

## conf/layer.conf
```bitbake
# We have a conf and classes directory, add to BBPATH
BBPATH .= ":${LAYERDIR}"

# We have recipes-* directories, add to BBFILES
BBFILES += "${LAYERDIR}/recipes-*/*/*.bb \
            ${LAYERDIR}/recipes-*/*/*.bbappend"

BBFILE_COLLECTIONS += "meta-quantumyocto"
BBFILE_PATTERN_meta-quantumyocto = "^${LAYERDIR}/"
BBFILE_PRIORITY_meta-quantumyocto = "6"

LAYERDEPENDS_meta-quantumyocto = "core"
LAYERSERIES_COMPAT_meta-quantumyocto = "walnascar"
```
